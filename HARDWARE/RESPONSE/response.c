#include "response.h"
#include "delay.h"
#include "usart.h"	 
#include "string.h"

typedef unsigned char uint8;
typedef unsigned short uint16;

uint16 RedundancyCheck;

unsigned char controlStep =0;

u16 LaserPm25=0;
u16 LaserPm10=0;

#define ErrorMax 3
unsigned char PmErrorCnt = 0;


// 低字节CRC值表
uint8  auchCRCLo[] = 
{
0x00, 0xC0, 0xC1, 0x01, 0xC3, 0x03, 0x02, 0xC2, 0xC6, 0x06, 0x07, 0xC7, 0x05, 0xC5, 0xC4,
0x04, 0xCC, 0x0C, 0x0D, 0xCD, 0x0F, 0xCF, 0xCE, 0x0E, 0x0A, 0xCA, 0xCB, 0x0B, 0xC9, 0x09,
0x08, 0xC8, 0xD8, 0x18, 0x19, 0xD9, 0x1B, 0xDB, 0xDA, 0x1A, 0x1E, 0xDE, 0xDF, 0x1F, 0xDD,
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0x44, 0x84, 0x85, 0x45, 0x87, 0x47, 0x46, 0x86, 0x82, 0x42, 0x43, 0x83, 0x41, 0x81, 0x80,
0x40
};  

// 高字节CRC值表
uint8 auchCRCHi[] = 
{
0x00, 0xC1, 0x81, 0x40, 0x01, 0xC0, 0x80, 0x41, 0x01, 0xC0, 0x80, 0x41, 0x00, 0xC1, 0x81,
0x40, 0x01, 0xC0, 0x80, 0x41, 0x00, 0xC1, 0x81, 0x40, 0x00, 0xC1, 0x81, 0x40, 0x01, 0xC0,
0x80, 0x41, 0x01, 0xC0, 0x80, 0x41, 0x00, 0xC1, 0x81, 0x40, 0x00, 0xC1, 0x81, 0x40, 0x01,
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0x00, 0xC1, 0x81, 0x40, 0x01, 0xC0, 0x80, 0x41, 0x01, 0xC0, 0x80, 0x41, 0x00, 0xC1, 0x81,
0x40
};

uint16 Modbus_CRC16(uint8 *Buff_addr,uint16 len)
{                           
	// 函数返回值是无符号短整型CRC值
  // 待进行CRC校验计算的报文
  // 待校验的报文长度
	uint8 uchCRCHi = 0xFF;             // CRC高字节的初始化
	uint8 uchCRCLo = 0xFF;             // CRC低字节的初始化
	uint16 uIndex;                           // CRC查找表的指针
	while (len--)								
	{
		uIndex = uchCRCLo ^ *Buff_addr++;      // 计算CRC
		uchCRCLo = uchCRCHi ^ auchCRCHi[uIndex];
		uchCRCHi = auchCRCLo[uIndex];
	}
	return(uchCRCHi <<8 | uchCRCLo);
}

void CleanSent_Buffer()
{
 memset(USART_TX_BUF, 0, USART_REC_LEN );
}

void CleanRec_Buffer(unsigned char *dat)
{
	memset(dat, 0, USART_REC_LEN );
}
//协议总长32字节
//0 0x42  固定帧头
//1 0x4d  固定帧头
//2 0x00  帧长度高八位
//3 0x1c  帧长度低八位
//4 0x00  CF=1,标准颗粒物 PM1.0 单位ug/m3 高八位
//5 0x1c  CF=1,标准颗粒物 PM1.0 单位ug/m3 低八位
//6 0x00  CF=1,标准颗粒物 PM2.5 单位ug/m3 高八位
//7 0x27  CF=1,标准颗粒物 PM2.5 单位ug/m3 低八位
//8 0x00  CF=1,标准颗粒物 PM10  单位ug/m3 高八位
//9 0x2B  CF=1,标准颗粒物 PM10  单位ug/m3 低八位
//10 0x00 大气环境下 PM1.0浓度  单位ug/m3 高八位
//11 0x18 大气环境下 PM1.0浓度  单位ug/m3 低八位
//12 0x00 大气环境下 PM2.5浓度  单位ug/m3 高八位
//13 0x23 大气环境下 PM2.5浓度  单位ug/m3 低八位
//14 0x00 大气环境下 PM10浓度   单位ug/m3 高八位
//15 0x2B 大气环境下 PM10浓度   单位ug/m3 低八位
//16 0x13 0.1L空气中直径在0.3um以上的颗粒物个数 高八位
//17 0x20 0.1L空气中直径在0.3um以上的颗粒物个数 低八位
//18 0x05 0.1L空气中直径在0.5um以上的颗粒物个数 高八位
//19 0xAD 0.1L空气中直径在0.5um以上的颗粒物个数 低八位
//20 0x00 0.1L空气中直径在1.0um以上的颗粒物个数 高八位
//21 0xD0 0.1L空气中直径在1.0um以上的颗粒物个数 低八位
//22 0x00 0.1L空气中直径在2.5um以上的颗粒物个数 高八位
//23 0x15 0.1L空气中直径在2.5um以上的颗粒物个数 低八位
//24 0x00 0.1L空气中直径在5.0um以上的颗粒物个数 高八位
//25 0x03 0.1L空气中直径在5.0um以上的颗粒物个数 低八位
//26 0x00 0.1L空气中直径在10um以上的颗粒物个数 高八位
//27 0x00 0.1L空气中直径在10um以上的颗粒物个数 低八位
//28 0x00 版本号
//29 0x00 错误代码
//30 0x03 校验位高八位
//31 0xCC 校验位低八位

unsigned char CheackDat( unsigned char *dat)
{
	if((dat[0]==0x42)&&(dat[1]==0x4D))
	{
		LaserPm25 = 10 *( (dat[12]<<8)|(dat[13]) );
		LaserPm10 = 10 *( (dat[14]<<8)|(dat[15]) );
		PmErrorCnt = 0;
		return 1;
	}
	else
	{
		if( PmErrorCnt++ > ErrorMax ){
			LaserPm10 = LaserPm25 = 0;
			PmErrorCnt = ErrorMax;
		}
		return 0;
	}
}


//苏静粉尘仪
//01 03 9c 46 00 06 0a 4d
//01 03 0C    00 00 00 00     00 00 01 A2    00 00 00 07   2A BA  
//            TSP             PM 2.5         PM10

//RedundancyCheck = Rec_Buf_T[5]|(Rec_Buf_T[6]<<8);
		
//if(RedundancyCheck == Modbus_CRC16(Rec_Buf_T,5))	// CRC校验
unsigned char CheackDat2( unsigned char *dat)
{
	int i =0;
	
	if((dat[0]==0x01)&&(dat[1]==0x03))
	{
		USART2_TX_BUF[0] = 0x01;
		USART2_TX_BUF[1] = 0x03;
		USART2_TX_BUF[2] = 0x0C;
		
		USART2_TX_BUF[3] = 0x00;
		USART2_TX_BUF[4] = 0x00;
		USART2_TX_BUF[5] = 0x00;
		USART2_TX_BUF[6] = 0x00;
		
		USART2_TX_BUF[7] = 0x00;
		USART2_TX_BUF[8] = 0x00;
		USART2_TX_BUF[9] = ((LaserPm25*10)&0xFF00)>>8;
		USART2_TX_BUF[10] = (LaserPm25*10)&0x00FF;
		
		USART2_TX_BUF[11] = 0x00;
		USART2_TX_BUF[12] = 0x00;
		USART2_TX_BUF[13] = ((LaserPm10*10)&0xFF00)>>8;
		USART2_TX_BUF[14] = (LaserPm10*10)&0x00FF;
		
		RedundancyCheck = Modbus_CRC16(USART2_TX_BUF,15);
		
		USART2_TX_BUF[15] = RedundancyCheck&0x00FF;	
		USART2_TX_BUF[16] = (RedundancyCheck&0xFF00)>>8;
		
		for(i=0;i<17;i++)
		{ 
			USART_SendData(USART2, USART2_TX_BUF[i]);  
			while(USART_GetFlagStatus(USART2,USART_FLAG_TC)!=SET);
			//等待发送结束
		}
		return 0;
	}
	else
	{
		return 1;
	}
}

//控制命令  
void Rest()
{    
	unsigned char len =0,t=0;
	CleanSent_Buffer();
	USART_TX_BUF[0] = START;
	USART_TX_BUF[1] = ACK;
	USART_TX_BUF[2] = 0;
	USART_TX_BUF[3] = STOP;
	len	= 4;				
	for(t=0;t<len;t++)
	{ 
		USART_SendData(USART1, USART_TX_BUF[t]);  
		while(USART_GetFlagStatus(USART1,USART_FLAG_TC)!=SET);
		//等待发送结束
	}
}



//应答帧
void ACKpro(unsigned char  errorcode)
{     
	unsigned char len =0,t=0;
	CleanSent_Buffer();
	USART_TX_BUF[0] = START;
	USART_TX_BUF[1] = ACK;
	USART_TX_BUF[2] = errorcode;
	USART_TX_BUF[3] = STOP;
	len	= 4;				
	for(t=0;t<len;t++)
	{ 
		USART_SendData(USART1, USART_TX_BUF[t]);  
		while(USART_GetFlagStatus(USART1,USART_FLAG_TC)!=SET);
		//等待发送结束
	}
}


//结束帧
void ENDpro()
{    
	unsigned char len =0,t=0;
	CleanSent_Buffer();
	USART_TX_BUF[0] = START;
	USART_TX_BUF[1] = ACK;
	USART_TX_BUF[2] = ENDFRAME;
	USART_TX_BUF[3] = STOP;
	len	= 4;				
	for(t=0;t<len;t++)
	{ 
		USART_SendData(USART1, USART_TX_BUF[t]);  
		while(USART_GetFlagStatus(USART1,USART_FLAG_TC)!=SET);
		//等待发送结束
	}
}


  
//SET  RES  PA5-6

void PMS_IO_Init(void)
{
 
	GPIO_InitTypeDef  GPIO_InitStructure;
	RCC_APB2PeriphClockCmd(RCC_APB2Periph_GPIOA, ENABLE);	 //使能PA端口时钟
	
	GPIO_InitStructure.GPIO_Pin = GPIO_Pin_5|GPIO_Pin_6;				  
	GPIO_InitStructure.GPIO_Mode = GPIO_Mode_Out_PP; 		 //推挽输出
	GPIO_InitStructure.GPIO_Speed = GPIO_Speed_50MHz;		 //IO口速度为50MHz
	GPIO_Init(GPIOA, &GPIO_InitStructure);					  
	GPIO_SetBits(GPIOA,GPIO_Pin_5|GPIO_Pin_6);						  
	
}

	
